## meta-allwinner-i2c-spi-arduino/conf/layer.conf
```bitbake
# We have a conf and classes directory, add to BBPATH
BBPATH .= ":${LAYERDIR}"

# We have recipes-* directories, add to BBFILES
BBFILES += "${LAYERDIR}/recipes-*/*/*.bb \
	${LAYERDIR}/recipes-*/*/*.bbappend"

BBFILE_COLLECTIONS += "allwinner-i2c-spi-arduino"
BBFILE_PATTERN_allwinner-i2c-spi-arduino = "^${LAYERDIR}/"
BBFILE_PRIORITY_allwinner-i2c-spi-arduino = "9"

# New addition in sumo
LAYERVERSION_allwinner-i2c-spi-arduino = "10"
LAYERSERIES_COMPAT_allwinner-i2c-spi-arduino = "sumo thud warrior zeus"
```
